## package/raspberrypi/raspir/Config.in
```kconfig
config BR2_PACKAGE_RASPIR
	bool "raspir"
	help
		Enables raspir Infrared kernel module
		for Panasonic IR sending and receiving
		on Raspberry Pi)
```
